## apps/app013-openhd/meta-openhd/conf/layer.conf
```bitbake
# SPDX-License-Identifier: MIT
# Private development layer: explicitly included by this app's kas config.
BBPATH .= ":${LAYERDIR}"
BBFILES += "${LAYERDIR}/recipes-*/*/*.bb ${LAYERDIR}/recipes-*/*/*.bbappend"
BBFILE_COLLECTIONS += "q6a-openhd"
BBFILE_PATTERN_q6a-openhd := "^${LAYERDIR}/"
BBFILE_PRIORITY_q6a-openhd = "9"
LAYERDEPENDS_q6a-openhd = "core qcom-apps"
LAYERSERIES_COMPAT_q6a-openhd = "wrynose"
Q6A_OPENHD_LAYERDIR := "${LAYERDIR}"
LICENSE_PATH += "${@d.getVar('Q6A_OPENHD_LAYERDIR') + '/licenses' if d.getVar('QCOM_APP') == 'app013-openhd' else ''}"
```

## layers/meta-qcom-distro/conf/distro/include/qcom-ota.inc
```bitbake
# SPDX-License-Identifier: MIT
# All Qualcomm production images are OTA images unless explicitly disabled.
QCOM_OTA_ENABLE ??= "1"
QCOM_OTA_CHANNEL ??= "stable"
QCOM_OTA_VERSION ??= "${DISTRO_VERSION}.0"
QCOM_OTA_BOOT_BACKEND ??= "${@'systemd-boot' if bb.utils.contains('MACHINE_FEATURES', 'efi', True, False, d) else 'fixed'}"
QCOM_OTA_BOOT_BACKEND:radxa-dragon-q6a = "embloader"
QCOM_OTA_BOOT_BACKEND:qcom-armv7a = "fixed"
QCOM_OTA_MIN_FREE_KIB ??= "524288"

DISTRO_FEATURES:append = "${@' sota usrmerge' if d.getVar('QCOM_OTA_ENABLE') == '1' else ''}"
DISTRO_FEATURES_NATIVE:append = "${@' sota' if d.getVar('QCOM_OTA_ENABLE') == '1' else ''}"
DISTRO_FEATURES_OPTED_OUT:append = "${@' ptest' if d.getVar('QCOM_OTA_ENABLE') == '1' else ''}"
INHERIT += "${@'qcom_ota' if d.getVar('QCOM_OTA_ENABLE') == '1' else ''}"
INITRAMFS_IMAGE = "${@'initramfs-ostree-image' if d.getVar('QCOM_OTA_ENABLE') == '1' else 'initramfs-rootfs-image'}"
```

## layers/meta-radxa-dragon/conf/machine/include/qcom-sc8280xp.inc
```bitbake
# Configurations and variables for the Qualcomm SC8280XP SoC family.

SOC_FAMILY = "sc8280xp"
require conf/machine/include/qcom-base.inc
require conf/machine/include/qcom-common.inc

DEFAULTTUNE = "armv8-2a-crypto"
require conf/machine/include/arm/arch-armv8-2a.inc

MACHINE_ESSENTIAL_EXTRA_RRECOMMENDS += " \
    packagegroup-qcom-boot-essential \
    packagegroup-machine-essential-qcom-sc8280xp-soc \
"

MACHINE_EXTRA_RRECOMMENDS += " \
    packagegroup-qcom-boot-additional \
"
```
